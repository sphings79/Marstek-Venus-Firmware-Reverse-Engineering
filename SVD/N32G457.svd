# N32G457 register map
Vendor: NSING TECHNOLOGIES PTE. LTD.; File version: 1.0
Registers are 32-bit, read-write, reset 0x0 unless marked. A register's access mark holds for its fields unless they carry their own. Offsets are from the block's base; lines under a group give offsets from that group; [hi:lo] are bit positions; {n}, {i} and the like mark numbered series; 'fields as' and 'values as' point back to an identical list; <NAME> marks a mode.

## Memory map
0x40000000 TIM2 size 0x400 — General purpose timer
0x40000400 TIM3 size 0x400
0x40000800 TIM4 size 0x400
0x40000C00 TIM5 size 0x400
0x40001000 TIM6 size 0x400 — Basic timer
0x40001400 TIM7 size 0x400
0x40002000 OPAMP size 0x400 — operational amplifier
0x40002400 COMP size 0xA0 — comparator
0x40002800 RTC size 0x400 — Real time clock
0x40002C00 WWDG size 0x400 — window watchdog
0x40003000 IWDG size 0x400 — Independent watchdog
0x40003400 TSC size 0x400 — touch screen control
0x40003800 SPI2 size 0x400 — Serial peripheral interface
0x40003C00 SPI3 size 0x400 — Serial peripheral interface
0x40004400 USART2 size 0x400
0x40004800 USART3 size 0x400
0x40004C00 UART4 size 0x400 — Universal asynchronous receiver transmitter
0x40005000 UART5 size 0x400
0x40005400 I2C1 size 0x400 — Inter integrated circuit
0x40005800 I2C2 size 0x400 — Inter integrated circuit
0x40005C00 USB size 0x400 — Universal serial bus full-speed device interface
0x40006400 CAN1 size 0x400 — Controller area network
0x40006800 CAN2 size 0x400
0x40006C00 BKP size 0xC0 — Backup registers
0x40007000 PWR size 0x400 — Power control
0x40007400 DAC size 0x38 — digital to analog converter
0x40010000 AFIO size 0x400 — Alternate function I/O
0x40010400 EXTI size 0x20 — external interrupt/event controller
0x40010800 GPIOA size 0x400 — General purpose I/O
0x40010C00 GPIOB size 0x400
0x40011000 GPIOC size 0x400
0x40011400 GPIOD size 0x400
0x40011800 GPIOE size 0x400
0x40011C00 GPIOF size 0x400
0x40012000 GPIOG size 0x400
0x40012C00 TIM1 size 0x400 — Advanced timer
0x40013000 SPI1 size 0x400 — Serial peripheral interface
0x40013400 TIM8 size 0x400 — Advanced timer
0x40013800 USART1 size 0x400 — Universal synchronous asynchronous receiver transmitter
0x40014400 I2C3 size 0x400 — Inter integrated circuit
0x40014800 I2C4 size 0x400 — Inter integrated circuit
0x40014C00 DVP size 0x20 — Digital video port
0x40015000 UART6 size 0x400
0x40015400 UART7 size 0x400
0x40018000 SDIO size 0x400 — Secure digital input/output interface
0x40020000 DMA1 size 0xB0 — Direct memory access controller
0x40020400 DMA2 size 0xB0 — DMA2: Direct memory access controller
0x40020800 ADC1 size 0x68 — analog to digital converter
0x40020C00 ADC2 size 0x68 — analog to digital converter
0x40021000 RCC size 0x40 — Reset and clock control
0x40021800 ADC3 size 0x68 — analog to digital converter
0x40021C00 ADC4 size 0x68 — analog to digital converter
0x40022000 FLASH size 0x38 — interal FLASH controller
0x40023000 CRC size 0x20 — cyclic redundancy check
0x40028000 ETH size 0x2000 — Ethernet: media access control
0xA0001000 QSPI size 0x400 — Queued SPI
0xE0042000 DBG size 0x400 — debug support for MCU

## Interrupts
0 WWDG — WWDG interrupt
1 PVD (PWR) — PVD through EXTI line detection interrupt
3 RTC — RTC global interrupt
4 FLASH — FLASH interrupt
5 RCC — RCC interrupt
6 EXTI0 (EXTI) — EXTI0 interrupt
7 EXTI1 (EXTI) — EXTI1 interrupt
8 EXTI2 (EXTI) — EXTI2 interrupt
9 EXTI3 (EXTI) — EXTI3 interrupt
10 EXTI4 (EXTI) — EXTI4 interrupt
11 DMA1_Channel1 (DMA1) — DMA1 channel1 interrupt
12 DMA1_Channel2 (DMA1) — DMA1 channel2 interrupt
13 DMA1_Channel3 (DMA1) — DMA1 channel3 interrupt
14 DMA1_Channel4 (DMA1) — DMA1 channel4 interrupt
15 DMA1_Channel5 (DMA1) — DMA1 channel5 interrupt
16 DMA1_Channel6 (DMA1) — DMA1 channel6 interrupt
17 DMA1_Channel7 (DMA1) — DMA1 channel7 interrupt
18 ADC1_2 (ADC1, ADC2) — ADC1/ADC2 global interrupt
19 CAN1_TX (CAN1) — CAN1 TX interrupts
20 CAN1_RX0 (CAN1) — CAN1 RX0 interrupts
21 CAN1_RX1 (CAN1) — CAN1 RX1 interrupts
22 CAN1_SCE (CAN1) — CAN1 SCE interrupt
23 EXTI9_5 (EXTI) — EXTI5/6/7/8/9 interrupt
24 TIM1_BRK (TIM1) — TIM1 Break interrupt
25 TIM1_UP (TIM1) — TIM1 Update interrupt
26 TIM1_TRG_COM (TIM1) — TIM1 Trigger and Commutation interrupts
27 TIM1_CC (TIM1) — TIM1 Capture Compare interrupt
28 TIM2 — TIM2 global interrupt
29 TIM3 — TIM3 global interrupt
30 TIM4 — TIM4 global interrupt
31 I2C1_EV (I2C1) — I2C1 Event interrupt
32 I2C1_ER (I2C1) — I2C1 Error interrupt
33 I2C2_EV (I2C2) — I2C2 Event interrupt
34 I2C2_ER (I2C2) — I2C2 Error interrupt
35 SPI1 — SPI1 global interrupt
36 SPI2 — SPI2 global interrupt
37 USART1 — USART1 global interrupt
38 USART2 — USART2 global interrupt
39 USART3 — USART3 global interrupt
40 EXTI15_10 (EXTI) — EXTI10/11/12/13/14/15 interrupt
41 RTCAlarm (RTC) — RTC Alarms through EXTI line interrupt
42 USBWakeUp (USB) — USB Device WakeUp from suspend through EXTI Line Interrupt
43 TIM8_BRK (TIM8) — TIM8 Break interrupt
44 TIM8_UP (TIM8) — TIM8 Update interrupt
45 TIM8_TRG_COM (TIM8) — TIM8 Trigger and Commutation interrupts
46 TIM8_CC (TIM8) — TIM8 Capture Compare interrupt
47 ADC3_4 (ADC3, ADC4) — ADC3/ADC4 global interrupt
49 SDIO — SDIO global interrupt
50 TIM5 — TIM5 global interrupt
51 SPI3 — SPI3 global interrupt
52 UART4 — UART4 global interrupt
53 UART5 — UART5 global interrupt
54 TIM6 — TIM6 global interrupt
55 TIM7 — TIM7 global interrupt
56 DMA2_Channel1 (DMA2) — DMA2 channel1 interrupt
57 DMA2_Channel2 (DMA2) — DMA2 channel2 interrupt
58 DMA2_Channel3 (DMA2) — DMA2 channel3 interrupt
59 DMA2_Channel4 (DMA2) — DMA2 channel4 interrupt
60 DMA2_Channel5 (DMA2) — DMA2 channel5 interrupt
61 ETH — Ethernet global interrupt
62 ETH_WKUP (ETH) — Ethernet Wakeup through EXTI line interrupt
63 CAN2_TX (CAN2) — CAN2 TX interrupts
64 CAN2_RX0 (CAN2) — CAN2 RX0 interrupts
65 CAN2_RX1 (CAN2) — CAN2 RX1 interrupts
66 CAN2_SCE (CAN2) — CAN2 SCE interrupt
67 QSPI — QSPI global interrupt
68 DMA2_Channel6 (DMA2) — DMA2 channel6 interrupt
69 DMA2_Channel7 (DMA2) — DMA2 channel7 interrupt
70 I2C3_EV (I2C3) — I2C3 Event interrupt
71 I2C3_ER (I2C3) — I2C3 Error interrupt
72 I2C4_EV (I2C4) — I2C4 Event interrupt
73 I2C4_ER (I2C4) — I2C4 Error interrupt
74 UART6 — UART6 global interrupt
75 UART7 — UART7 global interrupt
76 DMA1_Channel8 (DMA1) — DMA1 channel8 interrupt
77 DMA2_Channel8 (DMA2) — DMA2 channel8 interrupt
78 DVP — DVP interrupt
81 TSC — TSC global interrupt
82 COMP_1_2_3 (COMP) — COMP1/2/3 interrupt
83 COMP_4_5_6 (COMP) — COMP4/5/6 interrupt
84 COMP7 (COMP) — COMP7 interrupt
